## config/Kconfig.defconfig
```kconfig
if SHIELD_FLKB_LEFT

config ZMK_KEYBOARD_NAME
	default "FLKB"

config ZMK_SPLIT_ROLE_CENTRAL
	default y 

endif 

if SHIELD_FLKB_LEFT || SHIELD_FLKB_RIGHT

config ZMK_SPLIT
	default y
 
if ZMK_DISPLAY

config I2C
	default y

config SSD1306
	default y

config SSD1306_REVERSE_MODE
	default y

endif # ZMK_DISPLAY

if LVGL

config LV_Z_VDB_SIZE
    default 64

config LV_Z_DPI
    default 148

config LV_Z_BITS_PER_PIXEL
    default 1

choice LV_COLOR_DEPTH
    default LV_COLOR_DEPTH_1
endchoice

endif # LVGL

config ZMK_IDLE_TIMEOUT
    default 30000
config ZMK_SLEEP
    default n
config ZMK_IDLE_SLEEP_TIMEOUT
    default 900000
endif
```

## config/boards/arm/flkb/Kconfig
```kconfig
# SPDX-License-Identifier: MIT

config BOARD_ENABLE_DCDC
	bool "Enable DCDC mode"
	select SOC_DCDC_NRF52X
	default y
	depends on BOARD_FLKB_LEFT || BOARD_FLKB_RIGHT
```

## config/boards/arm/flkb/Kconfig.board
```kconfig
#
# Copyright (c) 2021 Polarity Works
# SPDX-License-Identifier: MIT
#

config BOARD_FLKB_LEFT
	bool "flkb_left"
	depends on SOC_NRF52840_QIAA

config BOARD_FLKB_RIGHT
	bool "flkb_right"
	depends on SOC_NRF52840_QIAA
```

## config/boards/arm/flkb/Kconfig.defconfig
```kconfig
# BlueMicro840 board configuration

# Copyright (c) 2020 Pete Johanson, Derek Schmell
# SPDX-License-Identifier: MIT

if BOARD_FLKB_LEFT
    config ZMK_KEYBOARD_NAME
    default "flkb"
endif

if BOARD_FLKB_RIGHT
    config ZMK_KEYBOARD_NAME
    default "flkb_right"
endif

if BOARD_FLKB_LEFT || BOARD_FLKB_RIGHT

    config BOARD
        default "flkb"

    config ZMK_SPLIT
        default y

    config SPI
        bool
        default y

    config BT_CTLR
    	default BT
    
    config ZMK_BLE
    	default y
    
    config ZMK_USB
    	default y

    if USB
    
        config USB_NRFX
        	default y
        
        config USB_DEVICE_STACK
        	default y
    
    endif # USB

    config ZMK_BATTERY_VOLTAGE_DIVIDER
    	default y
    
    config SPI
    	default y
endif
```

## config/boards/arm/flkb/flkb_left_defconfig
```kconfig
#
# Copyright (c) 2021 Polarity Works
# SPDX-License-Identifier: MIT
#

CONFIG_SOC_SERIES_NRF52X=y
CONFIG_SOC_NRF52840_QIAA=y
CONFIG_BOARD_FLKB_LEFT=y
CONFIG_ZMK_BLE=y

CONFIG_ZMK_SPLIT=y
CONFIG_ZMK_SPLIT_ROLE_CENTRAL=y

# Enable MPU
CONFIG_ARM_MPU=y

# enable GPIO
CONFIG_GPIO=y

# LED_Indicators
CONFIG_LED_GPIO=y
CONFIG_ZMK_LED_INDICATORS=y
CONFIG_ZMK_LED_INDICATORS_BRT=80

# Enable SPI
CONFIG_SPI=y
CONFIG_SPI_NRFX=y

# Enable writing to flash
CONFIG_USE_DT_CODE_PARTITION=y
CONFIG_MPU_ALLOW_FLASH_WRITE=y
CONFIG_NVS=y
CONFIG_SETTINGS_NVS=y
CONFIG_FLASH=y
CONFIG_FLASH_PAGE_LAYOUT=y
CONFIG_FLASH_MAP=y

# Enable 32kHz crystal
CONFIG_CLOCK_CONTROL_NRF_K32SRC_XTAL=y
CONFIG_CLOCK_CONTROL_NRF_K32SRC_500PPM=y

# CONFIG_ZMK_RGB_UNDERGLOW=y
# CONFIG_ZMK_RGB_UNDERGLOW_EXT_POWER=y
# CONFIG_ZMK_RGB_UNDERGLOW_ON_START=y
# CONFIG_ZMK_RGB_UNDERGLOW_EFF_START=4
# CONFIG_ZMK_RGB_UNDERGLOW_AUTO_OFF_IDLE=y

# Use the STRIP config specific to the LEDs you're using
# CONFIG_WS2812_STRIP=y
# CONFIG_PWM=y
# CONFIG_LED_PWM=y
# CONFIG_ZMK_BACKLIGHT=y
# CONFIG_ZMK_BACKLIGHT_AUTO_OFF_IDLE=y

#BT configuration
CONFIG_BT_CTLR_TX_PWR_PLUS_8=y
CONFIG_BT_DIS_MANUF="FLKB Corporation"
CONFIG_BT_PRIVACY=n
CONFIG_BT_GAP_PERIPHERAL_PREF_PARAMS=y
CONFIG_BT_PERIPHERAL_PREF_TIMEOUT=600
CONFIG_BT_PERIPHERAL_PREF_MIN_INT=12
CONFIG_BT_PERIPHERAL_PREF_MAX_INT=24
CONFIG_BT_PERIPHERAL_PREF_LATENCY=30
CONFIG_BT_BAS=n #Set this to y to enable BLE battery reporting

#Misc configuration
CONFIG_USB_DEVICE_VID=0x29EA
CONFIG_USB_DEVICE_PID=0x0362
CONFIG_USB_DEVICE_MANUFACTURER="FLKB Corporation"
CONFIG_ZMK_HID_REPORT_TYPE_NKRO=y
CONFIG_ZMK_HID_CONSUMER_REPORT_USAGES_BASIC=y
CONFIG_BUILD_OUTPUT_UF2=y
```

## config/boards/shields/flkb/Kconfig.defconfig
```kconfig
if SHIELD_FLKB_DONGLE

config ZMK_KEYBOARD_NAME
	default "FLKB"

config ZMK_SPLIT_ROLE_CENTRAL
	default y 

endif 

if SHIELD_FLKB_DONGLE || SHIELD_FLKB_LEFT || SHIELD_FLKB_RIGHT

config ZMK_SPLIT
	default y

config SPI
    bool
    default y

config BT_CTLR
    default BT

config ZMK_BLE
    default y

config ZMK_USB
    default y

config ZMK_BATTERY_VOLTAGE_DIVIDER
    default y

if USB

config USB_NRFX
    default y

config USB_DEVICE_STACK
    default y

endif # USB


if ZMK_DISPLAY

config I2C
	default y

config SSD1306
	default y

config SSD1306_REVERSE_MODE
	default y

endif # ZMK_DISPLAY

if LVGL

config LV_Z_VDB_SIZE
    default 64

config LV_Z_DPI
    default 148

config LV_Z_BITS_PER_PIXEL
    default 1

choice LV_COLOR_DEPTH
    default LV_COLOR_DEPTH_1
endchoice

endif # LVGL

config ZMK_IDLE_TIMEOUT
    default 30000
config ZMK_SLEEP
    default n
config ZMK_IDLE_SLEEP_TIMEOUT
    default 900000
endif
```

## config/boards/shields/flkb/Kconfig.shield
```kconfig
# Copyright (c) 2020 The ZMK Contributors
# SPDX-License-Identifier: MIT

config SHIELD_FLKB_LEFT
	def_bool $(shields_list_contains,flkb_left)

config SHIELD_FLKB_RIGHT
	def_bool $(shields_list_contains,flkb_right)
```

## config/west.yml
```yaml
manifest:
  remotes:
    - name: zmkfirmware
      url-base: https://github.com/zmkfirmware
    - name: fujisheng
      url-base: https://github.com/fujisheng
    - name: refil
      url-base: https://github.com/refil
  projects:
    - name: zmk_ReFil
      remote: fujisheng
      revision: adv360-z3.2-2
      import: app/west.yml
  self:
    path: config
```
